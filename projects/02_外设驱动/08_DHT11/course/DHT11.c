#include <DHT11.h>


//初始化
void DHT11_Init(void){

    GPIO_InitTypeDef	GPIO_InitStructure;		//结构定义
	GPIO_InitStructure.Pin  = GPIO_Pin_6;		//指定要初始化的IO,
	GPIO_InitStructure.Mode = GPIO_PullUp;	//指定IO的输入或输出方式,GPIO_PullUp,GPIO_HighZ,GPIO_OUT_OD,GPIO_OUT_PP
	GPIO_Inilize(GPIO_P4, &GPIO_InitStructure);//初始化
}

//获取温湿度
//参数：
//      指针，用来接受温度和湿度的数据
//返回值：
//      0：成功
//      -1：主机释放总线时间超时
//      -2：从机响应低电平时间超时
//      -3：从机响应高电平时间超时      
//      -4：信号0或1低电平时间超时
//      -5：信号0或1高电平时间超时
//      -6：数据校验失败
int DHT11_GetTempAndHumidity(TH * th){
    //0. 先定义一个变量，用来存放数的数
    int count , i  , j;
    u8 dat[5] ={0}; // 用来接受温湿度数据，5个字节，共40位，默认值都是 0 

    //1. 主机起始信号 :: 要拉低P46至少18 ~ 30ms 典型值: 20ms
    DHT11 = 0;		//拉低
    delay_ms(20);	//延时
    DHT11 = 1;		//拉高  -- P46 = 1

    //2. 主机释放总线时间 :: 高电平持续10 ~ 35us 典型值: 13us
    calc_high_and_low_time(1, 10, 35, "主机释放总线时间超时", -1);


    //3. 从机响应低电平时间 :: 低电平持续 78 ~ 88us 典型值: 83us
    calc_high_and_low_time(0, 78, 88, "从机响应低电平时间超时", -2);


    //4. 从机响应高电平时间 :: 高电平持续 80 ~ 92us 典型值: 87us
    calc_high_and_low_time(1, 80, 92, "从机响应高电平时间超时", -3);

    //5. 开始接收数据
    //5.1 由于从机发过来的是40位的数据，我们希望每8个二进制位作为一个整体，放到数组的每一个元素中，所以这里最好的办法就是嵌套循环
    //5.2 外层循环控制数组的元素，内层循环控制每一个元素的8个二进制位
    //5.3 外层循环的次数是 5 次，内层循环的次数是 8 次
    for ( i = 0; i < 5; i++){
        for( j = 7 ; j >=0  ; j--){

            //5.4 每一位数据的起始信号 :: 低电平持续 50 ~ 58 典型值: 54us
            calc_high_and_low_time(0, 45, 58, "信号0或1低电平时间", -4);

            //5.5 数据位的高电平时间 :: 高电平持续 26 ~ 29 典型值: 28us
            calc_high_and_low_time(1, 23, 74, "信号0或1高电平时间", -5);
            
            //5.6 判断是0还是1了 0 = 0000 0000

            //5.6.1 先判断高电平时间是否大于 48us ，如果大于48us，那么就是1，否则就是0
            // 0的话就不用操作了，因为默认这个字节的二进制位就是0，只去修改相应的1即可
        if(count > 48){
            dat[i] |=  (1 << j);
        }
        }
    }

    //6. 校验数据  dat[0]+dat[1]+dat[2]+dat[3] = dat[4]
    if (dat[0] + dat[1] + dat[2] + dat[3] != dat[4]){
        return -6; //校验失败
    }

    //7. 数据是准确的 :: 计算温度和湿度

    //7.0 计算湿度 低8位是0，所以只需要取高8位， 直接赋值dat[0]
    th->hum = dat[0]; //湿度

    //7.1 计算温度 高8位是整数，低8位是小数 【最高位是1，即表示是零下 ，如果是0，则表示零上】，所以需要计算
    th->temp = dat[2] + (dat[3]&0x7F) * 0.1; //温度

    //7.2 判断正负
    th->temp = dat[3]& 0x80 ? -th->temp : th->temp; //判断正负

    //7.3 返回0，即表示正常获取到温湿度
    return 0;
}